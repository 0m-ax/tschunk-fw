## boards/tschunk/tschunk_esp32s2/Kconfig.tschunk_esp32s2
```kconfig
# ESP32S2 LOLIN S2 MINI board configuration

# Copyright (c) 2023 Google, LLC
# SPDX-License-Identifier: Apache-2.0

config BOARD_TSCHUNK_ESP32S2
	select SOC_ESP32S2_N4R2
```

## drivers/gpio/Kconfig.m5stm32f0
```kconfig
# PCA953X GPIO configuration options

# Copyright (c) 2018 Aapo Vienamo
# Copyright (c) 2021 Laird Connectivity
# SPDX-License-Identifier: Apache-2.0

menuconfig GPIO_M5STM32F0
	bool "M5 STM32F0 I2C GPIO chip"
	default y
	select I2C
	help
	  Enable driver for PCA953X I2C GPIO chip.
```

## dts/bindings/gpio/m5,stm32f0.yaml
```yaml
# Copyright (c) 2018, Aapo Vienamo
# Copyright (c) 2021, Laird Connectivity
# SPDX-License-Identifier: Apache-2.0

description: TCA9538 GPIO node

compatible: "m5,stm32f0"

include: [i2c-device.yaml, gpio-controller.yaml]

properties:
  "#gpio-cells":
    const: 2

gpio-cells:
  - pin
  - flags
```

## west.yml
```yaml
manifest:

  remotes:
    - name: zephyr
      url-base: https://github.com/zephyrproject-rtos

  projects:
    - name: zephyr
      remote: zephyr
      repo-path: zephyr
      revision: main
      path: zephyr
      import:
         path-prefix: sdk
         name-blocklist:
           - zephyr
```
